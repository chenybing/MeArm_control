/*
 * ============================================================
 *  meArm 机械臂 · 任务一（2）固定指令通信
 *  考核方向：算法（控制、视觉）方向 · 二面考核
 * ============================================================
 *
 * ────────────────────────────────────────────────────────────
 * 【这个程序要解决的问题】
 * ────────────────────────────────────────────────────────────
 * 上一份程序（基础控制）是"人用手摇杆"操控机械臂。
 * 这一份要换成"电脑发指令"操控：
 *   电脑通过 USB 串口发一个字符给 Arduino，
 *   Arduino 收到后让夹爪执行对应动作。
 *
 * ────────────────────────────────────────────────────────────
 * 【编程思路（一句话）】
 * ────────────────────────────────────────────────────────────
 *   loop() 里不断问："串口有没有新数据进来？"
 *   有 → 读一个字符 → 用 switch-case 判断是哪个指令 → 执行对应动作。
 *
 * 指令表：
 *   O → 打开夹爪（转到 0°）
 *   S → 关闭夹爪（转到 180°）
 *   H → 加速（速度档 +1，最多 5 档）
 *   L → 减速（速度档 -1，最少 1 档）
 *
 * 为什么要做"速度档"？
 *   考核里常要求"控制舵机速度"，而舵机库本身没有调速接口，
 *   所以用一个很朴素的办法：夹爪每次只转 1°，每转 1° 就 delay 一下，
 *   delay 越短动作越快。档位越高 → 每步延时越短 → 夹爪越快。
 *
 * ────────────────────────────────────────────────────────────
 * 【串口通信小知识（入门必懂）】
 * ────────────────────────────────────────────────────────────
 *   - Serial.begin(9600)：约定传输速度 9600 波特（每秒 9600 位），
 *     电脑的串口监视器必须选同样的波特率，否则显示乱码。
 *   - Serial.available()：返回"缓冲区里积压了几个字符"。
 *     >0 就说明电脑发来了数据。
 *   - Serial.read()：从缓冲区里取一个字符（一次取一个）。
 *   - Serial.println(文字)：发一行文字给电脑显示。
 *   USB 传数据的时序：电脑可能一瞬间把整个字符串都倒进来，
 *   但 Arduino 一次只能 read 一个字符，所以要把 read 放进循环里
 *   把缓冲区的字符一个一个取出来处理。
 * ============================================================
 * 【硬件接线】（官方基准）
 * ============================================================
 *   夹爪舵机信号线 → D6（claw → D6）
 *   底座 D9 / 大臂 D7 / 小臂 D8 本程序没用，留着以后扩展。
 * ============================================================
 * 【测试方法】
 * ============================================================
 *   1. 上传程序后，打开 Arduino IDE 的「工具 → 串口监视器」；
 *   2. 波特率选 9600（右下角）；
 *   3. 在输入框里输入 O 或 S 或 H 或 L，点发送；
 *   4. 看夹爪动作 + 监视器里的回显文字。
 *   注意：串口监视器默认会帮你在每条消息后面加换行，
 *   我们只取第一个字符，所以加不加换行都不影响。
 * ============================================================
 */

#include <Servo.h>        // 引入舵机库（和上一份程序同一个库）

/* ============================================================
 * 引脚与参数定义
 * ============================================================ */
const int PIN_GRIPPER = 6;   // 夹爪舵机信号线引脚（claw → D6）

const int GRIPPER_OPEN  = 0;   // 打开角度：0° 时爪子张开
const int GRIPPER_CLOSE = 180; // 关闭角度：180° 时爪子闭合
                               // 【如果你的机械臂开合方向相反，
                               //   把这两个值对调即可（0 和 180 互换）】

const int SPEED_MIN = 1;       // 最慢档位（第 1 档）
const int SPEED_MAX = 5;       // 最快档位（第 5 档）
const int SPEED_DEFAULT = 3;   // 上电默认档位（中间档）

/* ============================================================
 * 全局变量
 * ============================================================ */
Servo servoGripper;            // 夹爪舵机对象（"遥控器"）
int   speedLevel = SPEED_DEFAULT;   // 当前速度档（1~5），会随着 H/L 变化
int   curGripper  = 90;             // 夹爪当前角度（程序自己记着）

/* ============================================================
 * setup()：开机执行一次
 * ============================================================ */
void setup() {
  // 绑定夹爪舵机到 D6
  servoGripper.attach(PIN_GRIPPER);
  // 上电先转到 90°（中间），避免突然跳转
  servoGripper.write(curGripper);

  // 打开串口，波特率 9600
  Serial.begin(9600);

  // 打印欢迎信息，告诉使用者有哪些指令
  Serial.println("READY | 指令: O=开爪  S=关爪  H=加速  L=减速");
  Serial.print("当前速度档: "); Serial.println(speedLevel);
}

/* ============================================================
 * loop()：主循环 —— 检查串口，收到指令就执行
 * ------------------------------------------------------------
 * 执行流程：available()>0 → read() 取字符 → switch 判断 → 动作
 * ============================================================ */
void loop() {
  // 只要串口缓冲区里有字符，就进来处理
  if (Serial.available() > 0) {
    char cmd = Serial.read();       // 取出一个字符（比如 'O'）

    // switch-case：拿 cmd 跟下面几个 case 逐一比对，命中就执行
    switch (cmd) {
      case 'O':                     // 指令 O = 打开夹爪
        Serial.println("CMD O: 打开夹爪");
        moveGripperTo(GRIPPER_OPEN);        // 转到 0°
        break;                      // break 很重要：执行完就跳出 switch

      case 'S':                     // 指令 S = 关闭夹爪
        Serial.println("CMD S: 关闭夹爪");
        moveGripperTo(GRIPPER_CLOSE);       // 转到 180°
        break;

      case 'H':                     // 指令 H = 加速
        speedLevel++;                       // 档位 +1
        if (speedLevel > SPEED_MAX) speedLevel = SPEED_MAX;  // 封顶
        Serial.print("加速 → 速度档: "); Serial.println(speedLevel);
        break;

      case 'L':                     // 指令 L = 减速
        speedLevel--;                       // 档位 -1
        if (speedLevel < SPEED_MIN) speedLevel = SPEED_MIN;  // 保底
        Serial.print("减速 → 速度档: "); Serial.println(speedLevel);
        break;

      default:                      // 其他字符：不是我们定义的指令
        // 换行符 '\n' 和回车符 '\r' 是电脑自动加的，忽略它们不报警告
        if (cmd != '\n' && cmd != '\r') {
          Serial.print("未知指令: "); Serial.println(cmd);
        }
        break;
    }
  }
}

/* ============================================================
 * moveGripperTo()：让夹爪平滑地转到目标角度
 * ------------------------------------------------------------
 * 【速度档是怎么实现调速的？】
 *   夹爪一次只转 1°，转完 delay 一小会儿再转下一步。
 *   delay 时间越短 → 单位时间转的度数越多 → 动作越快。
 *
 *   stepDelayMs = 50 - (档位-1) * 10
 *     第1档：50ms/步  → 最慢（50ms 才走 1°）
 *     第3档：30ms/步  → 中间
 *     第5档：10ms/步  → 最快
 * ------------------------------------------------------------
 * 【为什么用 while 循环而不是一次 write？】
 *   如果直接 write(180)，舵机会用全力"飞"过去，速度不可控，
 *   也不会有"慢速合爪"的效果。一格一格走才能控制速度。
 * ============================================================ */
void moveGripperTo(int target) {
  // 根据当前速度档算出每步延时（毫秒）
  int stepDelayMs = 50 - (speedLevel - 1) * 10;

  // while：只要还没到目标角度就一直走
  while (curGripper != target) {
    // 目标比当前大 → 加 1°；目标比当前小 → 减 1°（每次只动 1°）
    if (curGripper < target) curGripper++;
    else                     curGripper--;

    servoGripper.write(curGripper);   // 让舵机转到新的当前角度
    delay(stepDelayMs);               // 休息（决定速度的关键）
  }

  Serial.print("夹爪到位: "); Serial.println(target);   // 到位后回报
}
