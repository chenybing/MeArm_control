/*
 * ============================================================
 *  meArm 机械臂 · 任务一（3）多舵机协同控制
 *  考核方向：算法（控制、视觉）方向 · 二面考核
 * ============================================================
 *
 * ────────────────────────────────────────────────────────────
 * 【这个程序要解决的问题】
 * ────────────────────────────────────────────────────────────
 * 前面固定指令一次只控制 1 个关节（夹爪）。
 * 这次要"一条指令同时控制 3 个关节"：
 *
 *   电脑发送：x10,y30,z20
 *   Arduino ：底座转到 10°，大臂转到 30°，小臂转到 20°，
 *             而且三个舵机要【同时】转，不是一个个来。
 *
 * ────────────────────────────────────────────────────────────
 * 【编程思路（拆成两个难点）】
 * ────────────────────────────────────────────────────────────
 * 难点一：怎么把一串文字 "x10,y30,z20" 拆成三个数字？
 *   文字里藏着字母 x、y、z 当"标记"：
 *     第一步：indexOf('x') 找到 x 在第几个位置；
 *     第二步：取 x 后面、y 前面的那段字符（"10,"）；
 *     第三步：用 toInt() 把那段字符转成整数 10（toInt 会自动忽略
 *             非数字的逗号）。
 *   同理取 y 和 z。这叫"字符串解析"。
 *
 * 难点二：怎么让三个舵机"同时"转？
 *   舵机库的 write() 只控制一个舵机，看起来像"串行"。
 *   解决办法：写一个 moveSync() ——
 *     while 循环里，每一圈三个舵机【各自】朝目标走 1°，
 *     然后【连着】写三次 write()，最后统一 delay。
 *     因为三个 write 在同一个循环里连续执行，
 *     视觉上三个舵机就是同步转动的。
 *
 * ────────────────────────────────────────────────────────────
 * 【串口解析小知识】
 * ────────────────────────────────────────────────────────────
 *   String 类型：Arduino 里的一种"字符串"类型，可以装一串字符。
 *     str.indexOf('x')  → 返回字符 x 第一次出现的位置（从 0 数起）
 *     str.substring(a,b)→ 截取从位置 a 到位置 b 之间的一截
 *     str.toInt()       → 把字符串转成整数（遇到非数字自动停止）
 *   我们按"一行"来接收：loop 里把字符一个个攒进 serialBuffer，
 *   看到换行符 '\n' 就说明一条指令完整了，才开始解析。
 * ============================================================
 * 【硬件接线】（官方基准）
 * ============================================================
 *   底座舵机 → D9  （指令里的 x）
 *   大臂舵机 → D7  （指令里的 y）
 *   小臂舵机 → D8  （指令里的 z）
 *   夹爪没参与本程序（可以自己加第 4 个数）
 * ============================================================
 * 【测试方法】
 * ============================================================
 *   串口监视器（9600）发送：
 *     x10,y30,z20    → 三个关节同步转过去
 *     x180,y0,z90    → 再试别的组合
 *   注意勾选串口监视器右下角"发送新行"（或手动加回车）。
 * ============================================================
 */

#include <Servo.h>        // 引入舵机库

/* ============================================================
 * 引脚与参数定义
 * ============================================================ */
const int PIN_BASE     = 9;    // x → 底座舵机信号线（base → D9）
const int PIN_SHOULDER = 7;    // y → 大臂舵机信号线（D7）
const int PIN_ELBOW    = 8;    // z → 小臂舵机信号线（D8）

const int ANGLE_MIN = 0;       // 角度下限（舵机物理最小角度）
const int ANGLE_MAX = 180;     // 角度上限（舵机物理最大角度）

const int STEP_DELAY = 15;     // 同步移动时每走 1° 的延时（毫秒）。
                               // 调小 → 动作更快；调大 → 动作更慢更好观察。

/* ============================================================
 * 全局变量
 * ============================================================ */
Servo servoBase;        // 底座舵机对象
Servo servoShoulder;    // 大臂舵机对象
Servo servoElbow;       // 小臂舵机对象

int curBase     = 90;   // 底座当前角度（程序自己记着）
int curShoulder = 90;   // 大臂当前角度
int curElbow    = 90;   // 小臂当前角度

String serialBuffer = "";   // 串口接收缓冲：把字符攒成一行再解析

/* ============================================================
 * setup()：开机执行一次
 * ============================================================ */
void setup() {
  // 绑定三个舵机
  servoBase.attach(PIN_BASE);
  servoShoulder.attach(PIN_SHOULDER);
  servoElbow.attach(PIN_ELBOW);

  // 上电先回到 90°（中间安全位置）
  servoBase.write(90);
  servoShoulder.write(90);
  servoElbow.write(90);
  curBase = curShoulder = curElbow = 90;

  // 串口初始化
  Serial.begin(9600);
  Serial.println("READY | 格式: x角度,y角度,z角度  例如: x10,y30,z20");
}

/* ============================================================
 * loop()：主循环 —— 逐字符接收，攒够一行就解析执行
 * ------------------------------------------------------------
 * 接收流程（为什么用 while 而不是 if？）：
 *   Serial.available() 可能一次就有好几个字符排队，
 *   while 循环能把它们全部取干净，不会漏。
 * ============================================================ */
void loop() {
  while (Serial.available() > 0) {       // 只要缓冲区还有字符
    char c = Serial.read();              // 取出一个字符

    // 遇到换行符 '\n' 或回车符 '\r'：一条指令输入完毕
    if (c == '\n' || c == '\r') {
      if (serialBuffer.length() > 0) {   // 避免空行触发
        handleCommand(serialBuffer);     // 调用解析函数处理整条指令
        serialBuffer = "";               // 处理完清空缓冲，准备下一条
      }
    } else {
      serialBuffer += c;                 // 普通字符 → 追加到缓冲末尾
    }
  }
}

/* ============================================================
 * handleCommand()：解析 "x10,y30,z20" 并控制三个舵机
 * ------------------------------------------------------------
 * 以 "x10,y30,z20" 为例走一遍：
 *   indexOf('x') = 0   → ix=0
 *   indexOf('y') = 3   → iy=3
 *   indexOf('z') = 7   → iz=7
 *   substring(ix+1, iy) = substring(1,3) = "10," → toInt → 10
 *   substring(iy+1, iz) = substring(4,7) = "30," → toInt → 30
 *   substring(iz+1)     = substring(8)   = "20"  → toInt → 20
 * 完美！三个数字都拿到了。
 * ============================================================ */
void handleCommand(String cmd) {
  // 1. 找到 x、y、z 三个字母的位置（找不到会返回 -1）
  int ix = cmd.indexOf('x');
  int iy = cmd.indexOf('y');
  int iz = cmd.indexOf('z');

  // 2. 任何一个字母缺失 → 格式不对，提示并退出
  if (ix < 0 || iy < 0 || iz < 0) {
    Serial.println("ERR: 格式应为 x角度,y角度,z角度 例如: x10,y30,z20");
    return;                       // return = 提前结束这个函数
  }

  // 3. 按字母位置截取数字部分并转成整数
  int vx = cmd.substring(ix + 1, iy).toInt();   // x 的值
  int vy = cmd.substring(iy + 1, iz).toInt();   // y 的值
  int vz = cmd.substring(iz + 1).toInt();       // z 的值（截到结尾）

  // 4. 角度边界保护：constrain 把非法值拉回 0~180
  vx = constrain(vx, ANGLE_MIN, ANGLE_MAX);
  vy = constrain(vy, ANGLE_MIN, ANGLE_MAX);
  vz = constrain(vz, ANGLE_MIN, ANGLE_MAX);

  // 5. 回显解析结果（方便确认没解析错）
  Serial.print("CMD: x="); Serial.print(vx);
  Serial.print(" y=");    Serial.print(vy);
  Serial.print(" z=");    Serial.println(vz);

  // 6. 同步移动三个舵机（真正的执行动作）
  moveSync(vx, vy, vz);
  Serial.println("DONE");
}

/* ============================================================
 * moveSync()：三个舵机【同步】平滑移动到目标角度
 * ------------------------------------------------------------
 * 关键点：三个 write() 写在同一个循环里、最后统一 delay，
 * 所以三个舵机"同时起步、同时到位"，就是协同控制。
 * 每一圈每个舵机只走 1°，动作平滑可控。
 * ============================================================ */
void moveSync(int tx, int ty, int tz) {
  // 只要还有任何一个舵机没到目标，就一直循环
  while (curBase != tx || curShoulder != ty || curElbow != tz) {

    // 底座：向目标方向走 1°（目标大就加，目标小就减）
    if (curBase < tx)      curBase++;
    else if (curBase > tx) curBase--;

    // 大臂：同样走 1°
    if (curShoulder < ty)      curShoulder++;
    else if (curShoulder > ty) curShoulder--;

    // 小臂：同样走 1°
    if (curElbow < tz)      curElbow++;
    else if (curElbow > tz) curElbow--;

    // 【同步的关键】三个 write 连着执行，一瞬间同时输出 PWM
    servoBase.write(curBase);
    servoShoulder.write(curShoulder);
    servoElbow.write(curElbow);

    delay(STEP_DELAY);   // 统一延时 → 三个舵机速度一致
  }
}
