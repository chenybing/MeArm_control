/*
 * ============================================================
 *  meArm 机械臂 · 任务一（1）基础控制 —— 双摇杆实时操控
 *  考核方向：算法（控制、视觉）方向 · 二面考核
 * ============================================================
 *
 * ────────────────────────────────────────────────────────────
 * 【先认识 Arduino 程序的基本结构】（这是入门第一课）
 * ────────────────────────────────────────────────────────────
 * 每一个 Arduino 程序都有且只有两个函数：
 *
 *   setup()：上电后【只执行一次】。用来做准备工作，
 *            比如"把舵机信号线接到哪个引脚"、"串口用多少波特率"。
 *
 *   loop() ：上电后【无限循环执行】。程序的核心工作都在这，
 *            比如"读摇杆"、"算角度"、"转舵机"，一遍一遍重复。
 *
 * 打个比方：setup() 是开机时的"初始化"，loop() 是"主循环工作"。
 * ────────────────────────────────────────────────────────────
 * 【本程序的编程思路】（对应考核要求：四关节独立移动 + 摇杆实时操控）
 * ────────────────────────────────────────────────────────────
 * 思路一句话：死循环里反复做三件事 ——
 *   ① 用 analogRead() 读 4 个摇杆轴的电压值（0~1023 的数字）；
 *   ② 把电压值"换算"成对应的舵机目标角度（0~180）；
 *   ③ 用 servo.write() 让舵机转到目标角度。
 *   每循环一圈只做一点点调整，所以摇杆拨到哪，机械臂就跟到哪。
 *
 * 与官方示例 code.ino 相比，本程序额外加了三个"增强功能"：
 *   1. 死区（DEADZONE）：
 *      摇杆是电位器，回中时读数不是完美的 512，会有一点点抖动，
 *      如果抖动也被当成转动指令，舵机就会不停哆嗦。
 *      所以只要读数离中心 512 不超过 ±15，就当作"没动"。
 *   2. 平滑（SMOOTH）：
 *      如果不做平滑，角度会瞬间跳变，机械臂会"啪"地猛甩。
 *      平滑的做法：每次只朝目标方向靠近 30%，动作就变得柔和。
 *   3. 角度范围限制 + 方向反转开关：
 *      防止舵机转到机械结构不允许的角度（防撞），
 *      以及某个关节装反了时改一个 true/false 就能换方向。
 * ============================================================
 * 【硬件接线】（与官方 code.ino 完全一致）
 * ============================================================
 *   舵机信号线（橙色/白色那根）：
 *     底座舵机   → D9  （手臂左右旋转）
 *     大臂舵机   → D7  （操作杆上标 R）
 *     小臂舵机   → D8  （操作杆上标 L）
 *     夹爪舵机   → D6  （操作杆上标 claw）
 *   摇杆模块（5 根线：GND、+5V、X、Y、SW）：
 *     摇杆1 X → A0    摇杆1 Y → A1    摇杆1 按键 → D5
 *     摇杆2 X → A2    摇杆2 Y → A3    摇杆2 按键 → D4
 *   【重要】舵机供电不要只靠 USB，建议外接 5~6V/2A 电源并共地，
 *           否则供电不足会出现"卡卡"抖动。
 * ============================================================
 */

#include <Servo.h>        // 引入 Arduino 自带的舵机库。
                           // Servo 库的作用：把一个数字引脚变成"PWM 信号输出口"，
                           // 舵机是靠 PWM 信号控制转角的，write(角度) 就会发出对应信号。

/* ============================================================
 * 第一部分：引脚定义
 * ------------------------------------------------------------
 * const int 表示"常量"：值一旦定下来程序运行中就不能改。
 * 把引脚号统一写在文件最上面，好处是：
 *   以后想换引脚，只需要改这一处，不用满文件找数字。
 * ============================================================ */
const int PIN_BASE     = 9;    // 底座舵机的信号线引脚（base → D9）
const int PIN_SHOULDER = 7;    // 大臂舵机的信号线引脚（操作杆标 R → D7）
const int PIN_ELBOW    = 8;    // 小臂舵机的信号线引脚（操作杆标 L → D8）
const int PIN_GRIPPER  = 6;    // 夹爪舵机的信号线引脚（claw → D6）

const int PIN_J1_X = A0;       // 摇杆1 的 X 轴读数引脚 → 控制底座
const int PIN_J1_Y = A1;       // 摇杆1 的 Y 轴读数引脚 → 控制小臂
const int PIN_J2_X = A2;       // 摇杆2 的 X 轴读数引脚 → 控制夹爪
const int PIN_J2_Y = A3;       // 摇杆2 的 Y 轴读数引脚 → 控制大臂
                               // （轴和关节的对应关系 100% 照抄官方 code.ino）

const int PIN_BTN1 = 5;        // 摇杆1 的按键引脚（按下去接地）
const int PIN_BTN2 = 4;        // 摇杆2 的按键引脚

/* ============================================================
 * 第二部分：控制参数（想调手感就改这里）
 * ============================================================ */
const int JOY_CENTER  = 512;   // 摇杆的"居中值"。
                               // analogRead 返回 0~1023，摇杆拨到中间时大约是 512。
                               // 我们把 512 当作"零位"，偏离它多少就转多少。

const int DEADZONE    = 15;    // 死区大小（单位：读数刻度）。
                               // 读数离 512 小于 15 就当作没动。
                               // 如果舵机还是抖，把这个值调大到 30 或 40。

const float SMOOTH    = 0.15;   // 平滑系数（0~1 之间的小数）。
                               // 每次循环让角度向目标靠近"30%"。
                               // 越小动作越慢越柔（0.15），越大越跟手（0.4）。

/* 方向反转开关：如果某个关节"拨右却往左转"，把对应项改成 true 即可 */
const bool INVERT_BASE     = true;   // 底座方向是否反转
const bool INVERT_SHOULDER = true;   // 大臂方向是否反转
const bool INVERT_ELBOW    = true;   // 小臂方向是否反转
const bool INVERT_GRIPPER  = true;   // 夹爪方向是否反转

/* 各关节允许的角度范围。
 * 现在是 0~180（舵机物理极限），
 * 用 mearm_range_test 程序实测后，把安全范围填进来，
 * 防止舵机转到极限位置"卡卡"响甚至撞坏结构。 */
const int BASE_MIN     = 0;    // 底座角度下限
const int BASE_MAX     = 180;  // 底座角度上限
const int SHOULDER_MIN = 0;    // 大臂角度下限
const int SHOULDER_MAX = 180;  // 大臂角度上限（实测后收紧，比如 135）
const int ELBOW_MIN    = 0;    // 小臂角度下限
const int ELBOW_MAX    = 180;  // 小臂角度上限
const int GRIPPER_MIN  = 0;    // 夹爪角度下限（0°=张开）
const int GRIPPER_MAX  = 180;  // 夹爪角度上限（180°=闭合）

/* ============================================================
 * 第三部分：全局变量
 * ------------------------------------------------------------
 * 变量 = 可以随时改值的"小盒子"。
 * "当前角度"为什么要存成变量？
 *   因为舵机没有"读回自己角度"的功能，
 *   程序必须自己记着它现在转到哪了，才能知道下一步往哪走。
 * 用 float（小数）是因为平滑计算会产生小数，精度更高。
 * ============================================================ */
Servo servoBase;        // 底座舵机的"遥控器"对象。
                        // 我们不是直接往引脚写数字，而是通过 Servo 对象来操控，
                        // 比如 servoBase.write(90) 就表示让底座转到 90°。
Servo servoShoulder;    // 大臂舵机对象
Servo servoElbow;       // 小臂舵机对象
Servo servoGripper;     // 夹爪舵机对象

float curBase     = 90;  // 底座当前角度（上电后从 90° 开始）
float curShoulder = 90;  // 大臂当前角度
float curElbow    = 90;  // 小臂当前角度
float curGripper  = 90;  // 夹爪当前角度

/* ============================================================
 * setup()：开机只执行一次 —— 绑定舵机、回中间、初始化串口
 * ------------------------------------------------------------
 * 为什么上电先回 90°？因为 90° 是舵机的大致中间位置，
 * 先到一个"安全姿势"，避免一上电四个舵机乱跳、机械臂撞来撞去。
 * ============================================================ */
void setup() {
  // 1. 把 4 个 Servo 对象和物理引脚"绑定"在一起。
  //    绑定之后，servoBase.write(角度) 就等于给 D9 发 PWM 信号。
  servoBase.attach(PIN_BASE);
  servoShoulder.attach(PIN_SHOULDER);
  servoElbow.attach(PIN_ELBOW);
  servoGripper.attach(PIN_GRIPPER);

  // 2. 四个舵机先回到 90°（中间位置）。
  servoBase.write(90);
  servoShoulder.write(90);
  servoElbow.write(90);
  servoGripper.write(90);
  curBase = curShoulder = curElbow = curGripper = 90;  // 变量同步记成 90

  // 3. 摇杆按键引脚设为"内部上拉输入"：
  //    引脚内部自动接一个上拉电阻，不按时读到高电平(HIGH)，
  //    按下去（接地）时读到低电平(LOW)。这样按键不需要外接电阻。
  pinMode(PIN_BTN1, INPUT_PULLUP);
  pinMode(PIN_BTN2, INPUT_PULLUP);

  // 4. 初始化串口通信，波特率 9600。
  //    串口 = Arduino 和电脑用 USB 传数据的通道，
  //    Serial.println() 会把文字发到电脑的串口监视器上，方便看调试信息。
  Serial.begin(9600);
  Serial.println("READY | 拨动摇杆实时控制 4 个关节");
}

/* ============================================================
 * loop()：主循环，反复执行 —— 读摇杆 → 算角度 → 平滑移动
 * ------------------------------------------------------------
 * 这一圈跑完只需要十几毫秒，所以摇杆一动，机械臂马上就跟着动，
 * 给人的感觉就是"实时操控"。
 * ============================================================ */
void loop() {
  /* ---- 第一步：读 4 个摇杆轴的电压值 ----
   * analogRead(引脚) 返回 0~1023 的整数：
   *   摇杆拨到底一端 ≈ 0，拨到底另一端 ≈ 1023，中间 ≈ 512。
   * 注意轴与关节的对应关系（照抄官方 code.ino）：
   *   A0→底座  A1→小臂  A2→夹爪  A3→大臂  */
  int joyBase     = analogRead(PIN_J1_X);   // 底座 ← 摇杆1 的 X
  int joyElbow    = analogRead(PIN_J1_Y);   // 小臂 ← 摇杆1 的 Y
  int joyGripper  = analogRead(PIN_J2_X);   // 夹爪 ← 摇杆2 的 X
  int joyShoulder = analogRead(PIN_J2_Y);   // 大臂 ← 摇杆2 的 Y

  /* ---- 第二步：把每个摇杆读数换算成目标角度 ----
   * joyToAngle() 是我们自己写的函数（见下方定义）：
   *   - 摇杆在死区内 → 返回 -1（-1 是一个"约定"，表示"别动"）；
   *   - 摇杆在死区外 → 返回 0~180 之间的目标角度。
   * 返回值分别存进 tBase / tShoulder / tElbow / tGripper。 */
  int tBase     = joyToAngle(joyBase,     BASE_MIN,     BASE_MAX,     INVERT_BASE);
  int tShoulder = joyToAngle(joyShoulder, SHOULDER_MIN, SHOULDER_MAX, INVERT_SHOULDER);
  int tElbow    = joyToAngle(joyElbow,    ELBOW_MIN,    ELBOW_MAX,    INVERT_ELBOW);
  int tGripper  = joyToAngle(joyGripper,  GRIPPER_MIN,  GRIPPER_MAX,  INVERT_GRIPPER);

  /* ---- 第三步：平滑地移动过去 ----
   * smoothTo() 也是自定义函数：
   *   - 目标是 -1 → 不动；
   *   - 目标是个真角度 → 当前角度向目标靠近 30%，再 write 输出。
   * 这样每个循环只走一小步，四个关节同时在做，动作柔和连贯。 */
  smoothTo(servoBase,     curBase,     tBase);
  smoothTo(servoShoulder, curShoulder, tShoulder);
  smoothTo(servoElbow,    curElbow,    tElbow);
  smoothTo(servoGripper,  curGripper,  tGripper);

  delay(10);   // 每圈休息 10 毫秒：太快舵机反应不过来会抖，太慢就不跟手。
               // 10ms 是官方 code.ino 用的值，保持手感一致。
}

/* ============================================================
 * joyToAngle()：摇杆读数 → 目标角度  （自己写的工具函数）
 * ------------------------------------------------------------
 * 参数说明：
 *   joy      ：摇杆的读数（0~1023）
 *   minAngle ：这个关节允许的最小角度
 *   maxAngle ：这个关节允许的最大角度
 *   invert   ：是否反转方向（true=反，false=正）
 *
 * 返回值：
 *   -1 = 摇杆在死区里，不要动；
 *   其他 = 0~180 之间的目标角度。
 *
 * 换算原理（一条直线映射）：
 *   摇杆 0        → 角度 minAngle
 *   摇杆 1023     → 角度 maxAngle
 *   中间按比例取  → angle = minAngle + 读数/1023 * (maxAngle-minAngle)
 * ============================================================ */
int joyToAngle(int joy, int minAngle, int maxAngle, bool invert) {
  int offset = joy - JOY_CENTER;              // 先算出"偏离中间多少"（-512 ~ +512）

  if (offset > -DEADZONE && offset < DEADZONE) {
    return -1;                                // 死区内 → 返回 -1，表示保持不动
  }

  float ratio = (float)(joy - 0) / 1023.0;    // 把读数归一化成 0.0 ~ 1.0
                                              // 注意 (float) 强转：先变小数再除，
                                              // 否则整数除法会直接丢掉小数部分。
  int angle = minAngle + (int)(ratio * (maxAngle - minAngle));  // 按比例映射到角度范围

  if (invert) {
    angle = maxAngle - (angle - minAngle);    // 反转：把角度镜像一下
  }

  return constrain(angle, minAngle, maxAngle); // constrain(x, a, b)：把 x 限制在 a~b 之间
                                               // 超了下限取下限，超了上限取上限（安全保险）
}

/* ============================================================
 * smoothTo()：平滑移动 —— 当前角度一点点"追"目标角度
 * ------------------------------------------------------------
 * 参数说明：
 *   srv    ：要控制的舵机对象（& 表示引用，直接操作传进来的那个舵机）
 *   cur    ：当前角度变量（& 表示引用，函数里改了它，外面也跟着变）
 *   target ：目标角度（-1 = 不动）
 *
 * 原理：
 *   cur += (target - cur) * SMOOTH
 *   —— 每调用一次，cur 都向 target 靠近两者差值的 30%。
 *   （target - cur）是"还差多少"，乘以 0.3 就是"这次走三成"。
 *   永远差一点、永远追不上，于是动作是渐变的，不会瞬间跳变。
 * ============================================================ */
void smoothTo(Servo &srv, float &cur, int target) {
  if (target < 0) return;                     // -1 = 不移动，直接退出

  cur += (target - cur) * SMOOTH;             // 朝目标靠近 30%

  srv.write((int)cur);                        // write() 只接受整数角度，所以 (int) 取整
                                              // Servo 库内部会自动把角度限制在 0~180
}
